## system_image/buildroot_external/package/bhp-panel-ui/Config.in
```kconfig
config BR2_PACKAGE_BHP_PANEL_UI
	bool "bhp-panel-ui"
	depends on BR2_INSTALL_LIBSTDCPP
	depends on BR2_TOOLCHAIN_GCC_AT_LEAST_9 # complete C++17 support
	select BR2_PACKAGE_OPENSSL
	select BR2_PACKAGE_OPENSSL_FORCE_LIBOPENSSL
	help
	  Build the neutral BeagleBone House Panel shell core and its sole
	  installed fail-dark lifecycle service executable.

	  This package is host-neutral software evidence only. No physical
	  display-commit or raw-input backend is enabled, so target service
	  activation and presentation readiness remain unavailable.

comment "bhp-panel-ui needs C++, gcc >= 9"
	depends on !BR2_INSTALL_LIBSTDCPP || !BR2_TOOLCHAIN_GCC_AT_LEAST_9
```

## system_image/buildroot_external/package/bhp-presence-sensor/Config.in
```kconfig
config BR2_PACKAGE_BHP_PRESENCE_SENSOR
	bool "bhp-presence-sensor"
	depends on BR2_LINUX_KERNEL
	help
	  Build the experimental house-panel PIR input module and the
	  board's inert experiment overlays listed by
	  BHP_BOARD_PRESENCE_OVERLAYS in config/boards/<BR2_BHP_BOARD_ID>.env.

	  FRDM i.MX 8M Plus: the custom-driver overlay is rendered from the
	  board profile and refuses to build until FRDM-GATE-PIR evidence
	  sets the PIR pin; the primary gpio-keys node is merged into the
	  boot DTB by bhp-board-device-tree instead.

	  BeagleBone Black (history): the custom-driver and stock
	  gpio-keys overlays for P9.21 / GPIO0_3.

	  Overlays installed here are not added to the boot flow and have
	  no electrical or wake-cycle verification. Never apply two
	  overlays that claim the same pad.

comment "bhp-presence-sensor needs a Linux kernel"
	depends on !BR2_LINUX_KERNEL
```

## system_image/buildroot_external/package/bhp-tailscale-official/Config.in
```kconfig
config BR2_PACKAGE_BHP_TAILSCALE_OFFICIAL
	bool "bhp-tailscale-official"
	depends on BR2_aarch64
	depends on !BR2_PACKAGE_TAILSCALE
	help
	  Tailscale 1.102.2 from Tailscale's official static arm64
	  archive, verified by SHA-256 (ADR 0010). Keeps the panel at
	  version parity with Lexinet without a Buildroot host-Go
	  upgrade. Node state and enrollment material are provisioned
	  outside the image.

comment "bhp-tailscale-official needs AArch64 and replaces the tailscale package"
	depends on !BR2_aarch64 || BR2_PACKAGE_TAILSCALE
```

## system_image/buildroot_external/package/bhp-vocabulary-panel/Config.in
```kconfig
config BR2_PACKAGE_BHP_VOCABULARY_PANEL
	bool "bhp-vocabulary-panel"
	depends on BR2_INSTALL_LIBSTDCPP
	depends on BR2_TOOLCHAIN_GCC_AT_LEAST_9 # complete C++17 support
	depends on BR2_TOOLCHAIN_HAS_THREADS # lvgl/libdrm
	select BR2_PACKAGE_LVGL
	select BR2_PACKAGE_LIBCURL
	select BR2_PACKAGE_LIBCURL_FORCE_TLS
	select BR2_PACKAGE_OPENSSL
	select BR2_PACKAGE_OPENSSL_FORCE_LIBOPENSSL
	select BR2_PACKAGE_CA_CERTIFICATES
	select BR2_PACKAGE_JSON_FOR_MODERN_CPP
	help
	  Build the BeagleBone House Panel flash-card state machine,
	  fixture terminal, LVGL renderer library, and provisional
	  HTTPS Lexinet adapter.

	  The adapter is compiled with TLS certificate verification,
	  but the real Lexinet HTTP contract and target display/touch
	  controller remain unverified. The target service is disabled
	  until those boundaries are implemented and tested.

comment "bhp-vocabulary-panel needs C++, gcc >= 9, threads"
	depends on !BR2_INSTALL_LIBSTDCPP || \
		!BR2_TOOLCHAIN_GCC_AT_LEAST_9 || !BR2_TOOLCHAIN_HAS_THREADS
```

## system_image/buildroot_external/package/lvgl/Config.in
```kconfig
config BR2_PACKAGE_LVGL
	bool "lvgl"
	depends on BR2_TOOLCHAIN_HAS_THREADS # libdrm
	select BR2_PACKAGE_LIBDRM
	help
	  LVGL 9.5.0 configured for the BeagleBone house panel with the
	  software renderer, DRM dumb buffers, fbdev, and explicit evdev
	  input.

	  GPU/EGL/GBM, window-system, automatic input discovery,
	  examples, and demos are intentionally disabled.

	  https://lvgl.io/

comment "lvgl needs a toolchain with threads"
	depends on !BR2_TOOLCHAIN_HAS_THREADS
```
