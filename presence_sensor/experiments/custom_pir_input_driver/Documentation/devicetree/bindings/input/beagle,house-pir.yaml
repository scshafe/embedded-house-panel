## presence_sensor/experiments/custom_pir_input_driver/Documentation/devicetree/bindings/input/beagle,house-pir.yaml
```yaml
# SPDX-License-Identifier: (GPL-2.0-only OR BSD-2-Clause)
%YAML 1.2
---
$id: http://devicetree.org/schemas/input/beagle,house-pir.yaml#
$schema: http://devicetree.org/meta-schemas/core.yaml#

title: Beagle House GPIO PIR presence sensor experiment

maintainers:
  - Beagle House Panel maintainers <maintainers@example.invalid>

description: |
  Experimental binding for a digital PIR output connected to one GPIO. The
  Linux input device reports EV_SW/SW_FRONT_PROXIMITY using the logical GPIO
  value. This binding does not imply that the selected GPIO is capable of
  waking a particular board from its deepest system sleep state.

properties:
  compatible:
    const: beagle,house-pir

  presence-gpios:
    maxItems: 1
    description: |
      Digital presence output. GPIO_ACTIVE_HIGH means the asserted electrical
      level represents presence; use GPIO_ACTIVE_LOW only when required by the
      actual sensor or intervening circuitry.

  label:
    $ref: /schemas/types.yaml#/definitions/string
    description: Descriptive Linux input device name.

  wakeup-source: true

required:
  - compatible
  - presence-gpios

additionalProperties: false

examples:
  - |
    #include <dt-bindings/gpio/gpio.h>

    presence-sensor {
        compatible = "beagle,house-pir";
        presence-gpios = <&gpio0 3 GPIO_ACTIVE_HIGH>;
        label = "Beagle House PIR custom experiment";
        wakeup-source;
    };
...
```

## system_image/buildroot_external/Config.in
```kconfig
menu "BeagleBone house panel"

config BR2_BHP_BOARD_ID
	string "House-panel board profile id"
	help
	  Selects config/boards/<id>.env, which external.mk includes so the
	  project packages build for that board. frdm-imx8mp is the active
	  development board (ADR 0008); beaglebone-black is deprecated
	  history. An empty or unknown id fails the build.

source "$BR2_EXTERNAL_BHP_PATH/package/bhp-panel-supervisor/Config.in"
source "$BR2_EXTERNAL_BHP_PATH/package/bhp-panel-ui/Config.in"
source "$BR2_EXTERNAL_BHP_PATH/package/bhp-vocabulary-panel/Config.in"
source "$BR2_EXTERNAL_BHP_PATH/package/bhp-presence-sensor/Config.in"
source "$BR2_EXTERNAL_BHP_PATH/package/bhp-board-device-tree/Config.in"
source "$BR2_EXTERNAL_BHP_PATH/package/bhp-nxp-mwifiex/Config.in"
source "$BR2_EXTERNAL_BHP_PATH/package/bhp-nxp-iw612-firmware/Config.in"
source "$BR2_EXTERNAL_BHP_PATH/package/lvgl/Config.in"

endmenu
```

## system_image/buildroot_external/configs/beaglebone_house_panel_bringup_defconfig
```kconfig
# NON-PRODUCTION board-characterization image. Keep security differences
# explicit instead of weakening beaglebone_house_panel_defconfig.
BR2_arm=y
BR2_cortex_a8=y
BR2_ARM_FPU_VFPV3=y
BR2_TOOLCHAIN_EXTERNAL=y
BR2_TOOLCHAIN_EXTERNAL_BOOTLIN=y
BR2_TOOLCHAIN_EXTERNAL_BOOTLIN_ARMV7_EABIHF_GLIBC_STABLE=y
BR2_GLOBAL_PATCH_DIR="board/beagleboard/beaglebone/patches"
BR2_DOWNLOAD_FORCE_CHECK_HASHES=y
BR2_ROOTFS_DEVICE_CREATION_DYNAMIC_MDEV=y
BR2_ROOTFS_OVERLAY="$(BR2_EXTERNAL_BHP_PATH)/board/beaglebone-house-panel/rootfs-overlay $(BR2_EXTERNAL_BHP_PATH)/board/beaglebone-house-panel/bringup/rootfs-overlay"
BR2_ROOTFS_POST_BUILD_SCRIPT="board/beagleboard/beaglebone/post-build.sh $(BR2_EXTERNAL_BHP_PATH)/board/beaglebone-house-panel/post-build.sh $(BR2_EXTERNAL_BHP_PATH)/board/beaglebone-house-panel/bringup/post-build.sh"
BR2_ROOTFS_POST_IMAGE_SCRIPT="support/scripts/genimage.sh"
BR2_ROOTFS_POST_SCRIPT_ARGS="-c board/beagleboard/beaglebone/genimage.cfg"
BR2_TARGET_GENERIC_HOSTNAME="beaglebone-house-panel-bringup"
BR2_TARGET_GENERIC_ISSUE="NON-PRODUCTION BeagleBone House Panel root-key-only bring-up image"
# Root password login remains locked. The bring-up post-build hook installs one
# caller-supplied public key, and Dropbear disables all password authentication.
# BR2_TARGET_ENABLE_ROOT_LOGIN is not set
BR2_SYSTEM_DHCP="eth0"
BR2_LINUX_KERNEL=y
BR2_LINUX_KERNEL_CUSTOM_VERSION=y
BR2_LINUX_KERNEL_CUSTOM_VERSION_VALUE="6.18.21"
BR2_LINUX_KERNEL_DEFCONFIG="omap2plus"
BR2_LINUX_KERNEL_DTS_SUPPORT=y
BR2_LINUX_KERNEL_INTREE_DTS_NAME="ti/omap/am335x-boneblack"
BR2_LINUX_KERNEL_NEEDS_HOST_OPENSSL=y
BR2_PACKAGE_BUSYBOX_SHOW_OTHERS=y
BR2_PACKAGE_XZ=y
BR2_PACKAGE_AM33X_CM3=y
BR2_PACKAGE_KMOD=y
BR2_PACKAGE_KMOD_TOOLS=y
BR2_PACKAGE_CA_CERTIFICATES=y
BR2_PACKAGE_CHRONY=y
BR2_PACKAGE_LIBGPIOD=y
BR2_PACKAGE_LIBGPIOD_TOOLS=y
BR2_PACKAGE_EVTEST=y
BR2_PACKAGE_LIBDRM=y
BR2_PACKAGE_LIBDRM_OMAP=y
BR2_PACKAGE_LIBDRM_INSTALL_TESTS=y
BR2_PACKAGE_DRM_INFO=y
BR2_PACKAGE_FB_TEST_APP=y
BR2_PACKAGE_TAILSCALE=y
BR2_PACKAGE_LVGL=y
# BR2_PACKAGE_LIBCURL_PROXY_SUPPORT is not set
# BR2_PACKAGE_LIBCURL_COOKIES_SUPPORT is not set
# BR2_PACKAGE_LIBCURL_EXTRA_PROTOCOLS_FEATURES is not set
BR2_PACKAGE_BHP_PANEL_SUPERVISOR=y
BR2_PACKAGE_BHP_VOCABULARY_PANEL=y
BR2_PACKAGE_BHP_PRESENCE_SENSOR=y
# Development-only remote provisioning and board inventory tools.
BR2_PACKAGE_DROPBEAR=y
BR2_PACKAGE_DROPBEAR_DISABLE_REVERSEDNS=y
BR2_PACKAGE_RSYNC=y
BR2_PACKAGE_DTC=y
BR2_PACKAGE_I2C_TOOLS=y
BR2_PACKAGE_STRACE=y
BR2_TARGET_ROOTFS_EXT2=y
BR2_TARGET_ROOTFS_EXT2_4=y
BR2_TARGET_UBOOT=y
BR2_TARGET_UBOOT_BUILD_SYSTEM_KCONFIG=y
BR2_TARGET_UBOOT_CUSTOM_VERSION=y
BR2_TARGET_UBOOT_CUSTOM_VERSION_VALUE="2026.04"
BR2_TARGET_UBOOT_BOARD_DEFCONFIG="am335x_evm"
BR2_TARGET_UBOOT_NEEDS_DTC=y
BR2_TARGET_UBOOT_NEEDS_OPENSSL=y
BR2_TARGET_UBOOT_NEEDS_GNUTLS=y
# BR2_TARGET_UBOOT_FORMAT_BIN is not set
BR2_TARGET_UBOOT_FORMAT_IMG=y
BR2_TARGET_UBOOT_SPL=y
BR2_TARGET_UBOOT_SPL_NAME="MLO"
BR2_PACKAGE_HOST_DOSFSTOOLS=y
BR2_PACKAGE_HOST_GENIMAGE=y
BR2_PACKAGE_HOST_KMOD_XZ=y
BR2_PACKAGE_HOST_MTOOLS=y
```

## system_image/buildroot_external/configs/beaglebone_house_panel_defconfig
```kconfig
BR2_arm=y
BR2_cortex_a8=y
BR2_ARM_FPU_VFPV3=y
BR2_TOOLCHAIN_EXTERNAL=y
BR2_TOOLCHAIN_EXTERNAL_BOOTLIN=y
BR2_TOOLCHAIN_EXTERNAL_BOOTLIN_ARMV7_EABIHF_GLIBC_STABLE=y
BR2_GLOBAL_PATCH_DIR="board/beagleboard/beaglebone/patches"
BR2_DOWNLOAD_FORCE_CHECK_HASHES=y
BR2_ROOTFS_DEVICE_CREATION_DYNAMIC_MDEV=y
BR2_ROOTFS_OVERLAY="$(BR2_EXTERNAL_BHP_PATH)/board/beaglebone-house-panel/rootfs-overlay"
BR2_ROOTFS_POST_BUILD_SCRIPT="board/beagleboard/beaglebone/post-build.sh $(BR2_EXTERNAL_BHP_PATH)/board/beaglebone-house-panel/post-build.sh"
BR2_ROOTFS_POST_IMAGE_SCRIPT="support/scripts/genimage.sh"
BR2_ROOTFS_POST_SCRIPT_ARGS="-c $(BR2_EXTERNAL_BHP_PATH)/board/beaglebone-house-panel/genimage.cfg"
BR2_TARGET_GENERIC_HOSTNAME="beaglebone-house-panel"
BR2_TARGET_GENERIC_ISSUE="BeagleBone House Panel prototype image"
# BR2_TARGET_ENABLE_ROOT_LOGIN is not set
BR2_SYSTEM_DHCP="eth0"
BR2_LINUX_KERNEL=y
BR2_LINUX_KERNEL_CUSTOM_VERSION=y
BR2_LINUX_KERNEL_CUSTOM_VERSION_VALUE="6.18.21"
BR2_LINUX_KERNEL_DEFCONFIG="omap2plus"
BR2_LINUX_KERNEL_CONFIG_FRAGMENT_FILES="$(BR2_EXTERNAL_BHP_PATH)/board/beaglebone-house-panel/linux-suspend-prerequisites.config"
BR2_LINUX_KERNEL_DTS_SUPPORT=y
BR2_LINUX_KERNEL_INTREE_DTS_NAME="ti/omap/am335x-boneblack"
BR2_LINUX_KERNEL_NEEDS_HOST_OPENSSL=y
BR2_PACKAGE_BUSYBOX_SHOW_OTHERS=y
BR2_PACKAGE_XZ=y
BR2_PACKAGE_AM33X_CM3=y
BR2_PACKAGE_KMOD=y
BR2_PACKAGE_KMOD_TOOLS=y
BR2_PACKAGE_CA_CERTIFICATES=y
BR2_PACKAGE_CHRONY=y
BR2_PACKAGE_LIBGPIOD=y
BR2_PACKAGE_LIBGPIOD_TOOLS=y
BR2_PACKAGE_EVTEST=y
BR2_PACKAGE_LIBDRM=y
BR2_PACKAGE_LIBDRM_OMAP=y
BR2_PACKAGE_LIBDRM_INSTALL_TESTS=y
BR2_PACKAGE_DRM_INFO=y
BR2_PACKAGE_FB_TEST_APP=y
BR2_PACKAGE_TAILSCALE=y
BR2_PACKAGE_LVGL=y
# BR2_PACKAGE_LIBCURL_PROXY_SUPPORT is not set
# BR2_PACKAGE_LIBCURL_COOKIES_SUPPORT is not set
# BR2_PACKAGE_LIBCURL_EXTRA_PROTOCOLS_FEATURES is not set
BR2_PACKAGE_BHP_PANEL_SUPERVISOR=y
BR2_PACKAGE_BHP_VOCABULARY_PANEL=y
BR2_PACKAGE_BHP_PRESENCE_SENSOR=y
BR2_TARGET_ROOTFS_EXT2=y
BR2_TARGET_ROOTFS_EXT2_4=y
BR2_TARGET_ROOTFS_EXT2_SIZE="512M"
BR2_TARGET_UBOOT=y
BR2_TARGET_UBOOT_BUILD_SYSTEM_KCONFIG=y
BR2_TARGET_UBOOT_CUSTOM_VERSION=y
BR2_TARGET_UBOOT_CUSTOM_VERSION_VALUE="2026.04"
BR2_TARGET_UBOOT_BOARD_DEFCONFIG="am335x_evm"
BR2_TARGET_UBOOT_NEEDS_DTC=y
BR2_TARGET_UBOOT_NEEDS_OPENSSL=y
BR2_TARGET_UBOOT_NEEDS_GNUTLS=y
# BR2_TARGET_UBOOT_FORMAT_BIN is not set
BR2_TARGET_UBOOT_FORMAT_IMG=y
BR2_TARGET_UBOOT_SPL=y
BR2_TARGET_UBOOT_SPL_NAME="MLO"
BR2_PACKAGE_HOST_DOSFSTOOLS=y
BR2_PACKAGE_HOST_GENIMAGE=y
BR2_PACKAGE_HOST_KMOD_XZ=y
BR2_PACKAGE_HOST_MTOOLS=y
```

## system_image/buildroot_external/configs/frdm_imx8mp_house_panel_defconfig
```kconfig
# FRDM i.MX 8M Plus + Waveshare 7inch DSI LCD (C) production image (ADR 0008).
# Derived from Buildroot 2026.05.1 freescale_imx8mpevk_defconfig (NXP BSP flow)
# moved to the lf-6.12.49-2.2.0 BSP (linux-imx, uboot-imx, imx-atf) and the
# FRDM U-Boot/DTS. NXP-licensed firmware is deliberately NOT selected; see
# board/beaglebone-house-panel/frdm-imx8mp/nxp-firmware-eula.fragment. Until a
# human records that decision, the image stops at imx8-boot-sd.bin.
BR2_aarch64=y
BR2_cortex_a53=y
BR2_TOOLCHAIN_EXTERNAL=y
BR2_TOOLCHAIN_EXTERNAL_BOOTLIN=y
BR2_TOOLCHAIN_EXTERNAL_BOOTLIN_AARCH64_GLIBC_STABLE=y
BR2_GLOBAL_PATCH_DIR="$(BR2_EXTERNAL_BHP_PATH)/board/beaglebone-house-panel/frdm-imx8mp/patches"
BR2_DOWNLOAD_FORCE_CHECK_HASHES=y
BR2_ROOTFS_DEVICE_CREATION_DYNAMIC_MDEV=y
BR2_ROOTFS_OVERLAY="$(BR2_EXTERNAL_BHP_PATH)/board/beaglebone-house-panel/rootfs-overlay"
BR2_ROOTFS_POST_BUILD_SCRIPT="$(BR2_EXTERNAL_BHP_PATH)/board/beaglebone-house-panel/post-build.sh"
BR2_ROOTFS_POST_IMAGE_SCRIPT="$(BR2_EXTERNAL_BHP_PATH)/board/beaglebone-house-panel/frdm-imx8mp/post-image.sh"
BR2_ROOTFS_POST_SCRIPT_ARGS="${UBOOT_DIR}/arch/arm/dts/imx8mp-frdm.dtb"
BR2_TARGET_GENERIC_HOSTNAME="frdm-imx8mp-house-panel"
BR2_TARGET_GENERIC_ISSUE="FRDM i.MX 8M Plus house panel prototype image"
BR2_TARGET_GENERIC_GETTY_PORT="ttymxc1"
# BR2_TARGET_ENABLE_ROOT_LOGIN is not set
BR2_SYSTEM_DHCP="eth0"
BR2_BHP_BOARD_ID="frdm-imx8mp"
BR2_LINUX_KERNEL=y
BR2_LINUX_KERNEL_CUSTOM_TARBALL=y
BR2_LINUX_KERNEL_CUSTOM_TARBALL_LOCATION="$(call github,nxp-imx,linux-imx,lf-6.12.49-2.2.0)/linux-imx-lf-6.12.49-2.2.0.tar.gz"
BR2_LINUX_KERNEL_DEFCONFIG="imx_v8"
BR2_LINUX_KERNEL_CONFIG_FRAGMENT_FILES="$(BR2_EXTERNAL_BHP_PATH)/board/beaglebone-house-panel/frdm-imx8mp/linux-frdm-imx8mp.config"
BR2_LINUX_KERNEL_DTS_SUPPORT=y
BR2_LINUX_KERNEL_INTREE_DTS_NAME="freescale/imx8mp-frdm-waveshare-7inch-c-panel"
BR2_LINUX_KERNEL_DTB_OVERLAY_SUPPORT=y
BR2_LINUX_KERNEL_NEEDS_HOST_OPENSSL=y
BR2_PACKAGE_BUSYBOX_SHOW_OTHERS=y
BR2_PACKAGE_XZ=y
BR2_PACKAGE_FREESCALE_IMX=y
BR2_PACKAGE_FREESCALE_IMX_PLATFORM_IMX8MP=y
BR2_PACKAGE_ALSA_UTILS=y
BR2_PACKAGE_ALSA_UTILS_AMIXER=y
BR2_PACKAGE_ALSA_UTILS_APLAY=y
BR2_PACKAGE_KMOD=y
BR2_PACKAGE_KMOD_TOOLS=y
BR2_PACKAGE_CA_CERTIFICATES=y
BR2_PACKAGE_CHRONY=y
BR2_PACKAGE_LIBGPIOD=y
BR2_PACKAGE_LIBGPIOD_TOOLS=y
BR2_PACKAGE_EVTEST=y
BR2_PACKAGE_LIBDRM=y
BR2_PACKAGE_LIBDRM_INSTALL_TESTS=y
BR2_PACKAGE_DRM_INFO=y
BR2_PACKAGE_FB_TEST_APP=y
BR2_PACKAGE_IW=y
BR2_PACKAGE_WPA_SUPPLICANT=y
BR2_PACKAGE_WPA_SUPPLICANT_NL80211=y
BR2_PACKAGE_TAILSCALE=y
BR2_PACKAGE_LVGL=y
# BR2_PACKAGE_LIBCURL_PROXY_SUPPORT is not set
# BR2_PACKAGE_LIBCURL_COOKIES_SUPPORT is not set
# BR2_PACKAGE_LIBCURL_EXTRA_PROTOCOLS_FEATURES is not set
BR2_PACKAGE_BHP_PANEL_SUPERVISOR=y
BR2_PACKAGE_BHP_PANEL_UI=y
BR2_PACKAGE_BHP_VOCABULARY_PANEL=y
BR2_PACKAGE_BHP_PRESENCE_SENSOR=y
BR2_PACKAGE_BHP_BOARD_DEVICE_TREE=y
BR2_PACKAGE_BHP_NXP_MWIFIEX=y
BR2_TARGET_ROOTFS_EXT2=y
BR2_TARGET_ROOTFS_EXT2_4=y
BR2_TARGET_ROOTFS_EXT2_SIZE="512M"
BR2_TARGET_ARM_TRUSTED_FIRMWARE=y
BR2_TARGET_ARM_TRUSTED_FIRMWARE_CUSTOM_TARBALL=y
BR2_TARGET_ARM_TRUSTED_FIRMWARE_CUSTOM_TARBALL_LOCATION="$(call github,nxp-imx,imx-atf,lf-6.12.49-2.2.0)/imx-atf-lf-6.12.49-2.2.0.tar.gz"
BR2_TARGET_ARM_TRUSTED_FIRMWARE_PLATFORM="imx8mp"
BR2_TARGET_ARM_TRUSTED_FIRMWARE_BL31=y
BR2_TARGET_UBOOT=y
BR2_TARGET_UBOOT_BUILD_SYSTEM_KCONFIG=y
BR2_TARGET_UBOOT_CUSTOM_TARBALL=y
BR2_TARGET_UBOOT_CUSTOM_TARBALL_LOCATION="$(call github,nxp-imx,uboot-imx,lf-6.12.49-2.2.0)/uboot-imx-lf-6.12.49-2.2.0.tar.gz"
BR2_TARGET_UBOOT_BOARD_DEFCONFIG="imx8mp_frdm"
BR2_TARGET_UBOOT_NEEDS_DTC=y
BR2_TARGET_UBOOT_NEEDS_OPENSSL=y
BR2_TARGET_UBOOT_NEEDS_GNUTLS=y
BR2_TARGET_UBOOT_NEEDS_UTIL_LINUX=y
BR2_TARGET_UBOOT_FORMAT_CUSTOM=y
BR2_TARGET_UBOOT_FORMAT_CUSTOM_NAME="u-boot-nodtb.bin"
BR2_TARGET_UBOOT_SPL=y
BR2_PACKAGE_HOST_DOSFSTOOLS=y
BR2_PACKAGE_HOST_GENIMAGE=y
BR2_PACKAGE_HOST_IMX_MKIMAGE=y
BR2_PACKAGE_HOST_KMOD_XZ=y
BR2_PACKAGE_HOST_MTOOLS=y
BR2_PACKAGE_HOST_UBOOT_TOOLS=y
BR2_PACKAGE_HOST_UBOOT_TOOLS_FIT_SUPPORT=y
```

## system_image/buildroot_external/package/bhp-board-device-tree/Config.in
```kconfig
config BR2_PACKAGE_BHP_BOARD_DEVICE_TREE
	bool "bhp-board-device-tree"
	depends on BR2_LINUX_KERNEL
	depends on BR2_LINUX_KERNEL_DTS_SUPPORT
	select BR2_PACKAGE_HOST_DTC
	help
	  Renders the board's project overlay template from
	  config/boards/<BR2_BHP_BOARD_ID>.env, compiles it, and merges it
	  into the vendor base DTB to produce the boot DTB named by
	  BHP_BOARD_BOOT_DTB.

	  Rendering refuses UNMEASURED profile values, so on the FRDM
	  i.MX 8M Plus the build fails until FRDM-GATE-PIR evidence sets the
	  PIR pin. The base DTB must be built with overlay symbols
	  (BR2_LINUX_KERNEL_DTB_OVERLAY_SUPPORT).

comment "bhp-board-device-tree needs a Linux kernel with device tree support"
	depends on !BR2_LINUX_KERNEL || !BR2_LINUX_KERNEL_DTS_SUPPORT
```

## system_image/buildroot_external/package/bhp-nxp-iw612-firmware/Config.in
```kconfig
config BR2_PACKAGE_BHP_NXP_IW612_FIRMWARE
	bool "bhp-nxp-iw612-firmware"
	help
	  NXP IW612 Wi-Fi/Bluetooth firmware from nxp-imx/imx-firmware
	  lf-6.12.49-2.2.0, matching bhp-nxp-mwifiex.

	  Licensed under the NXP Software License Agreement and not
	  redistributable. Never select this in a checked-in defconfig:
	  scripts/build/configure_buildroot.sh merges it only through
	  board/beaglebone-house-panel/frdm-imx8mp/nxp-firmware-eula.fragment
	  after a human records EULA acceptance in an accepted ADR and the
	  board profile names it (BHP_BOARD_NXP_FIRMWARE_EULA).

	  https://github.com/nxp-imx/imx-firmware
```

## system_image/buildroot_external/package/bhp-nxp-mwifiex/Config.in
```kconfig
config BR2_PACKAGE_BHP_NXP_MWIFIEX
	bool "bhp-nxp-mwifiex"
	depends on BR2_LINUX_KERNEL
	depends on !BR2_PACKAGE_NXP_MWIFIEX
	help
	  NXP moal/mlan Wi-Fi driver (GPL-2.0) pinned to the same NXP
	  BSP release as the FRDM i.MX 8M Plus kernel (lf-6.12.49-2.2.0).
	  Buildroot's nxp-mwifiex is pinned to lf-6.6.52_2.2.0, which
	  targets the 6.6 kernel series.

	  The IW612 firmware it loads is a separate, NXP-licensed package
	  (bhp-nxp-iw612-firmware) gated by a recorded human EULA
	  decision. FRDM-GATE-WIFI evidence decides whether suspend and
	  resume keep Wi-Fi usable.

	  https://github.com/nxp-imx/mwifiex

comment "bhp-nxp-mwifiex needs a Linux kernel to be built"
	depends on !BR2_LINUX_KERNEL
```

## system_image/buildroot_external/package/bhp-panel-supervisor/Config.in
```kconfig
config BR2_PACKAGE_BHP_PANEL_SUPERVISOR
	bool "bhp-panel-supervisor"
	depends on BR2_INSTALL_LIBSTDCPP
	depends on BR2_TOOLCHAIN_GCC_AT_LEAST_9 # C++17 std::from_chars
	depends on BR2_TOOLCHAIN_HAS_THREADS
	help
	  Build the deterministic BeagleBone House Panel policy
	  engine and the Linux panel_supervisord runtime.

	  The runtime provides explicit evdev, backlight, local IPC,
	  solar-time, and suspend adapters. These adapters are not yet
	  verified on the target assembly, so the accompanying SysV
	  service is disabled until an operator provisions and enables
	  complete target configuration.

comment "bhp-panel-supervisor needs C++, gcc >= 9, threads"
	depends on !BR2_INSTALL_LIBSTDCPP || \
		!BR2_TOOLCHAIN_GCC_AT_LEAST_9 || !BR2_TOOLCHAIN_HAS_THREADS
```
